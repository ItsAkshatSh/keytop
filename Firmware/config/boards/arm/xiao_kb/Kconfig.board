## Firmware/config/boards/arm/xiao_kb/Kconfig.defconfig
```kconfig
if BOARD_XIAO_KB

config ZMK_KEYBOARD_NAME
    default "XIAO KB"

config BUILD_OUTPUT_UF2
    default y

config USE_DT_CODE_PARTITION
    default y

config SYSTEM_CLOCK_SLOPPY_IDLE
    default y

config WATCHDOG
    default y

config WDT_DISABLE_AT_BOOT
    default n

config WDT_NRFX
    default y

config HWINFO
    default y

endif
```

## Firmware/config/boards/arm/xiao_kb/board.yml
```yaml
board:
  name: xiao_kb
  full_name: XIAO Keyboard
  vendor: seeed
  socs:
    - name: nrf52840
```

## Firmware/config/boards/arm/xiao_kb/xiao_kb.defconfig
```kconfig
CONFIG_SOC_NRF52840_QIAA = y

CONFIG_PM=y
CONFIG_PM_DEVICE=y
CONFIG_PM_DEVICE_RUNTIME=y

CONFIG_CLOCK_CONTROL_NRF_K32SRC_XTAL = y
CONFIG_CLOCK_CONTROL_NRF_K32SRC_20PPM = y

CONFIG_SYSTEM_CLOCK_SLOPPY_IDLE=y
```

## Firmware/config/boards/arm/xiao_kb/xiao_kb_defconfig
```kconfig
CONFIG_CLOCK_CONTROL_NRF_K32SRC_XTAL=y
CONFIG_CLOCK_CONTROL_NRF_K32SRC_20PPM=y

CONFIG_SYSTEM_CLOCK_SLOPPY_IDLE=y

CONFIG_WATCHDOG=y
CONFIG_WDT_DISABLE_AT_BOOT=n
CONFIG_WDT_NRFX=y

CONFIG_HWINFO=y

CONFIG_BUILD_OUTPUT_UF2=y
CONFIG_USE_DT_CODE_PARTITION=y
```

## Firmware/config/build/Kconfig/Kconfig.modules
```kconfig
config ZEPHYR_HAL_STM32_MODULE
	bool
	default y

config ZEPHYR_HAL_STM32_MODULE_BLOBS
	bool
menu "lvgl (C:/Users/USER/Documents/xiaokb/zmk-workspace/modules/lib/gui/lvgl)"
osource "C:/Users/USER/Documents/xiaokb/zmk-workspace/modules/lib/gui/lvgl/zephyr/Kconfig"
config ZEPHYR_LVGL_MODULE
	bool
	default y
endmenu
config ZEPHYR_ZMK_STUDIO_MESSAGES_MODULE
	bool
	default y
menu "canopennode (C:/Users/USER/Documents/xiaokb/zmk-workspace/modules/lib/canopennode)"
osource "$(ZEPHYR_CANOPENNODE_KCONFIG)"
config ZEPHYR_CANOPENNODE_MODULE
	bool
	default y
endmenu
menu "chre (C:/Users/USER/Documents/xiaokb/zmk-workspace/modules/lib/chre)"
osource "C:/Users/USER/Documents/xiaokb/zmk-workspace/modules/lib/chre/platform/zephyr/Kconfig"
config ZEPHYR_CHRE_MODULE
	bool
	default y
endmenu
menu "lz4 (C:/Users/USER/Documents/xiaokb/zmk-workspace/modules/lib/lz4)"
osource "$(ZEPHYR_LZ4_KCONFIG)"
config ZEPHYR_LZ4_MODULE
	bool
	default y
endmenu
menu "nanopb (C:/Users/USER/Documents/xiaokb/zmk-workspace/modules/lib/nanopb)"
osource "$(ZEPHYR_NANOPB_KCONFIG)"
config ZEPHYR_NANOPB_MODULE
	bool
	default y
endmenu
config ZEPHYR_PSA_ARCH_TESTS_MODULE
	bool
	default y
menu "sof (C:/Users/USER/Documents/xiaokb/zmk-workspace/modules/audio/sof)"
osource "C:/Users/USER/Documents/xiaokb/zmk-workspace/modules/audio/sof/zephyr/Kconfig"
config ZEPHYR_SOF_MODULE
	bool
	default y
endmenu
config ZEPHYR_TF_M_TESTS_MODULE
	bool
	default y
menu "tflite-micro (C:/Users/USER/Documents/xiaokb/zmk-workspace/optional/modules/lib/tflite-micro)"
osource "$(ZEPHYR_TFLITE_MICRO_KCONFIG)"
config ZEPHYR_TFLITE_MICRO_MODULE
	bool
	default y
endmenu
menu "thrift (C:/Users/USER/Documents/xiaokb/zmk-workspace/optional/modules/lib/thrift)"
osource "$(ZEPHYR_THRIFT_KCONFIG)"
config ZEPHYR_THRIFT_MODULE
	bool
	default y
endmenu
menu "lang-rust (C:/Users/USER/Documents/xiaokb/zmk-workspace/modules/lang/rust)"
osource "C:/Users/USER/Documents/xiaokb/zmk-workspace/modules/lang/rust/Kconfig"
config ZEPHYR_LANG_RUST_MODULE
	bool
	default y
endmenu
menu "zscilib (C:/Users/USER/Documents/xiaokb/zmk-workspace/modules/lib/zscilib)"
osource "C:/Users/USER/Documents/xiaokb/zmk-workspace/modules/lib/zscilib/Kconfig.zscilib"
config ZEPHYR_ZSCILIB_MODULE
	bool
	default y
endmenu
menu "acpica (C:/Users/USER/Documents/xiaokb/zmk-workspace/modules/lib/acpica)"
osource "$(ZEPHYR_ACPICA_KCONFIG)"
config ZEPHYR_ACPICA_MODULE
	bool
	default y
endmenu
menu "cmsis (C:/Users/USER/Documents/xiaokb/zmk-workspace/modules/hal/cmsis)"
osource "$(ZEPHYR_CMSIS_KCONFIG)"
config ZEPHYR_CMSIS_MODULE
	bool
	default y
endmenu
menu "cmsis-dsp (C:/Users/USER/Documents/xiaokb/zmk-workspace/modules/lib/cmsis-dsp)"
osource "$(ZEPHYR_CMSIS_DSP_KCONFIG)"
config ZEPHYR_CMSIS_DSP_MODULE
	bool
	default y
endmenu
menu "cmsis-nn (C:/Users/USER/Documents/xiaokb/zmk-workspace/modules/lib/cmsis-nn)"
osource "$(ZEPHYR_CMSIS_NN_KCONFIG)"
config ZEPHYR_CMSIS_NN_MODULE
	bool
	default y
endmenu
menu "fatfs (C:/Users/USER/Documents/xiaokb/zmk-workspace/modules/fs/fatfs)"
osource "$(ZEPHYR_FATFS_KCONFIG)"
config ZEPHYR_FATFS_MODULE
	bool
	default y
endmenu
config ZEPHYR_ADI_MODULE
	bool
	default y
menu "hal_ambiq (C:/Users/USER/Documents/xiaokb/zmk-workspace/modules/hal/ambiq)"
osource "$(ZEPHYR_HAL_AMBIQ_KCONFIG)"
config ZEPHYR_HAL_AMBIQ_MODULE
	bool
	default y
endmenu
config ZEPHYR_ATMEL_MODULE
	bool
	default y
menu "hal_espressif (C:/Users/USER/Documents/xiaokb/zmk-workspace/modules/hal/espressif)"
osource "C:/Users/USER/Documents/xiaokb/zmk-workspace/modules/hal/espressif/zephyr/Kconfig"
config ZEPHYR_HAL_ESPRESSIF_MODULE
	bool
	default y

config ZEPHYR_HAL_ESPRESSIF_MODULE_BLOBS
	bool
endmenu
menu "hal_ethos_u (C:/Users/USER/Documents/xiaokb/zmk-workspace/modules/hal/ethos_u)"
osource "$(ZEPHYR_HAL_ETHOS_U_KCONFIG)"
config ZEPHYR_HAL_ETHOS_U_MODULE
	bool
	default y
endmenu
menu "hal_gigadevice (C:/Users/USER/Documents/xiaokb/zmk-workspace/modules/hal/gigadevice)"
osource "$(ZEPHYR_HAL_GIGADEVICE_KCONFIG)"
config ZEPHYR_HAL_GIGADEVICE_MODULE
	bool
	default y
endmenu
menu "hal_intel (C:/Users/USER/Documents/xiaokb/zmk-workspace/modules/hal/intel)"
osource "C:/Users/USER/Documents/xiaokb/zmk-workspace/modules/hal/intel/zephyr/Kconfig"
config ZEPHYR_HAL_INTEL_MODULE
	bool
	default y
endmenu
menu "hal_nordic (C:/Users/USER/Documents/xiaokb/zmk-workspace/modules/hal/nordic)"
osource "$(ZEPHYR_HAL_NORDIC_KCONFIG)"
config ZEPHYR_HAL_NORDIC_MODULE
	bool
	default y

config ZEPHYR_HAL_NORDIC_MODULE_BLOBS
	bool
endmenu
config ZEPHYR_NUVOTON_MODULE
	bool
	default y
config ZEPHYR_QUICKLOGIC_MODULE
	bool
	default y
config ZEPHYR_HAL_RENESAS_MODULE
	bool
	default y

config ZEPHYR_HAL_RENESAS_MODULE_BLOBS
	bool
menu "hal_rpi_pico (C:/Users/USER/Documents/xiaokb/zmk-workspace/modules/hal/rpi_pico)"
osource "$(ZEPHYR_HAL_RPI_PICO_KCONFIG)"
config ZEPHYR_HAL_RPI_PICO_MODULE
	bool
	default y
endmenu
menu "hal_silabs (C:/Users/USER/Documents/xiaokb/zmk-workspace/modules/hal/silabs)"
osource "$(ZEPHYR_HAL_SILABS_KCONFIG)"
config ZEPHYR_HAL_SILABS_MODULE
	bool
	default y

config ZEPHYR_HAL_SILABS_MODULE_BLOBS
	bool
endmenu
menu "hal_tdk (C:/Users/USER/Documents/xiaokb/zmk-workspace/modules/hal/tdk)"
osource "$(ZEPHYR_HAL_TDK_KCONFIG)"
config ZEPHYR_HAL_TDK_MODULE
	bool
	default y
endmenu
menu "hal_telink (C:/Users/USER/Documents/xiaokb/zmk-workspace/modules/hal/telink)"
osource "C:/Users/USER/Documents/xiaokb/zmk-workspace/modules/hal/telink/Kconfig"
config ZEPHYR_HAL_TELINK_MODULE
	bool
	default y
endmenu
menu "hal_wch (C:/Users/USER/Documents/xiaokb/zmk-workspace/modules/hal/wch)"
osource "$(ZEPHYR_HAL_WCH_KCONFIG)"
config ZEPHYR_HAL_WCH_MODULE
	bool
	default y
endmenu
config ZEPHYR_HAL_WURTHELEKTRONIK_MODULE
	bool
	default y
menu "hostap (C:/Users/USER/Documents/xiaokb/zmk-workspace/modules/lib/hostap)"
osource "$(ZEPHYR_HOSTAP_KCONFIG)"
config ZEPHYR_HOSTAP_MODULE
	bool
	default y
endmenu
menu "liblc3 (C:/Users/USER/Documents/xiaokb/zmk-workspace/modules/lib/liblc3)"
osource "$(ZEPHYR_LIBLC3_KCONFIG)"
config ZEPHYR_LIBLC3_MODULE
	bool
	default y
endmenu
config ZEPHYR_LIBMCTP_MODULE
	bool
	default y
config ZEPHYR_LIBMETAL_MODULE
	bool
	default y
menu "littlefs (C:/Users/USER/Documents/xiaokb/zmk-workspace/modules/fs/littlefs)"
osource "$(ZEPHYR_LITTLEFS_KCONFIG)"
config ZEPHYR_LITTLEFS_MODULE
	bool
	default y
endmenu
menu "mbedtls (C:/Users/USER/Documents/xiaokb/zmk-workspace/modules/crypto/mbedtls)"
osource "$(ZEPHYR_MBEDTLS_KCONFIG)"
config ZEPHYR_MBEDTLS_MODULE
	bool
	default y
endmenu
config ZEPHYR_MIPI_SYS_T_MODULE
	bool
	default y
menu "nrf_wifi (C:/Users/USER/Documents/xiaokb/zmk-workspace/modules/lib/nrf_wifi)"
osource "$(ZEPHYR_NRF_WIFI_KCONFIG)"
config ZEPHYR_NRF_WIFI_MODULE
	bool
	default y

config ZEPHYR_NRF_WIFI_MODULE_BLOBS
	bool
endmenu
config ZEPHYR_OPEN_AMP_MODULE
	bool
	default y
menu "percepio (C:/Users/USER/Documents/xiaokb/zmk-workspace/modules/debug/percepio)"
osource "C:/Users/USER/Documents/xiaokb/zmk-workspace/modules/debug/percepio/zephyr/Kconfig"
config ZEPHYR_PERCEPIO_MODULE
	bool
	default y
endmenu
menu "picolibc (C:/Users/USER/Documents/xiaokb/zmk-workspace/modules/lib/picolibc)"
osource "C:/Users/USER/Documents/xiaokb/zmk-workspace/modules/lib/picolibc/zephyr/Kconfig"
config ZEPHYR_PICOLIBC_MODULE
	bool
	default y
endmenu
menu "segger (C:/Users/USER/Documents/xiaokb/zmk-workspace/modules/debug/segger)"
osource "$(ZEPHYR_SEGGER_KCONFIG)"
config ZEPHYR_SEGGER_MODULE
	bool
	default y
endmenu
config ZEPHYR_TINYCRYPT_MODULE
	bool
	default y
menu "trusted-firmware-a (C:/Users/USER/Documents/xiaokb/zmk-workspace/modules/tee/tf-a/trusted-firmware-a)"
osource "$(ZEPHYR_TRUSTED_FIRMWARE_A_KCONFIG)"
config ZEPHYR_TRUSTED_FIRMWARE_A_MODULE
	bool
	default y
endmenu
menu "uoscore-uedhoc (C:/Users/USER/Documents/xiaokb/zmk-workspace/modules/lib/uoscore-uedhoc)"
osource "$(ZEPHYR_UOSCORE_UEDHOC_KCONFIG)"
config ZEPHYR_UOSCORE_UEDHOC_MODULE
	bool
	default y
endmenu
menu "zcbor (C:/Users/USER/Documents/xiaokb/zmk-workspace/modules/lib/zcbor)"
osource "$(ZEPHYR_ZCBOR_KCONFIG)"
config ZEPHYR_ZCBOR_MODULE
	bool
	default y
endmenu
menu "config (C:/Users/USER/Documents/xiaokb/zmk-workspace/config)"
osource "C:/Users/USER/Documents/xiaokb/zmk-workspace/config/xiao_kb.conf"
config ZEPHYR_CONFIG_MODULE
	bool
	default y
endmenu
config ZEPHYR_NRF_HW_MODELS_MODULE
	bool
	default y
```

## Firmware/config/drivers/input/Kconfig
```kconfig
config INPUT_TPS65201A
    bool "TPS65201A PMIC"
    depends on y
    depends on DT_HAS_TI_TPS65201A_ENABLED
    depends on I2C
    depends on INPUT
    help
      This option enables support for the TPS65201A PMIC, which is used on some
      ZMK-compatible keyboards. It provides power management features and can be
      used to control the power supply to the keyboard's components.

      Enabling this option will allow ZMK to communicate with the TPS65201A PMIC
      over I2C, allowing it to manage power efficiently and potentially extend
      battery life on wireless keyboards.
```
